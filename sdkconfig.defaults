## sdkconfig.defaults
```kconfig
CONFIG_LOG_DEFAULT_LEVEL_DEBUG=y
CONFIG_LOG_MAXIMUM_LEVEL_DEBUG=y
CONFIG_ETH_USE_ESP32_EMAC=y
# Better throughput for RMII 100M: avoid fragmenting 1500B frames across 512B DMA buffers.
CONFIG_ETH_DMA_BUFFER_SIZE=1536
CONFIG_ETH_DMA_TX_BUFFER_NUM=30
CONFIG_ETH_DMA_RX_BUFFER_NUM=30
CONFIG_ETH_IRAM_OPTIMIZATION=y
CONFIG_ESP_NETIF_IP_LOST_TIMER_INTERVAL=120

# Improve TCP throughput over higher-latency links (e.g., internet downloads)
CONFIG_LWIP_WND_SCALE=y
CONFIG_LWIP_TCP_RCV_SCALE=3
CONFIG_LWIP_TCP_SND_BUF_DEFAULT=65535
CONFIG_LWIP_TCP_WND_DEFAULT=65535
CONFIG_LWIP_TCPIP_RECVMBOX_SIZE=64
CONFIG_LWIP_TCP_RECVMBOX_SIZE=64
CONFIG_LWIP_TCP_ACCEPTMBOX_SIZE=32
CONFIG_LWIP_TCPIP_TASK_STACK_SIZE=4096
```
